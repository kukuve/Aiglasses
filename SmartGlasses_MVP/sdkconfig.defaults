## SmartGlasses_MVP/sdkconfig.defaults
```kconfig
# Flash size: 4MB (matches ESP32-CAM hardware)
CONFIG_ESPTOOLPY_FLASHSIZE_4MB=y
CONFIG_ESPTOOLPY_FLASHSIZE="4MB"

# Enable PSRAM for ESP32-CAM
CONFIG_SPIRAM=y
CONFIG_SPIRAM_BOOT_INIT=y
CONFIG_SPIRAM_USE_CAPS_ALLOC=y
```
